## meta-beagle/conf/layer.conf
```bitbake
# We have a conf and classes directory, append to BBPATH
BBPATH .= ":${LAYERDIR}"

# We have a recipes directory, add to BBFILES
BBFILES += "${LAYERDIR}/recipes*/*/*.bb ${LAYERDIR}/recipes*/*/*.bbappend"

BBFILE_COLLECTIONS += "meta-beagle"
BBFILE_PATTERN_meta-beagle := "^${LAYERDIR}/"
BBFILE_PRIORITY_meta-beagle = "10"

LAYERSERIES_COMPAT_meta-beagle = "sumo thud"
```
